## arch/arm/mach-comcerto/Kconfig
```kconfig
menu "Comcerto Configuration"

config ARCH_HAS_LOWLEVEL_INIT
	bool
	default y


config BOARDINFO
        default "Mindspeed C2000"

menu "SoC Selection"

choice
	prompt "Select the SoC"

config	COMCERTO_C2000
	bool "C2000"
	select CPU_32v7
	help

endchoice


endmenu

menu "Board Selection"

choice
        prompt "Select the Board"

config  MACH_COMCERTO_C2K_EVM
        bool "EVM"
        help

config  MACH_COMCERTO_C2K_MFCNEVM 
        bool "MFCN_EVM"
        help

config  MACH_COMCERTO_C2K_ASIC
	bool "ASIC"
	help

config  MACH_COMCERTO_C2K_RTSM
	bool "RTSM"
	help

endchoice

endmenu

menu "Build Selection"

choice
	prompt "Build type:"
	default COMCERTO_VERIFICATION

config COMCERTO_VERIFICATION
	bool "Pre-Silicon Verification Code"
	select HAVE_NOSHELL
	select COMCERTO_NOT_BOOLOADER
	select HAVE_MMU
	select MMU
	select ARCH_HAS_L2X0
	select CACHE_L2X0
	help

config COMCERTO_DIAG
	bool "Diagnostic Code"
	select COMCERTO_NOT_BOOLOADER
	select COMCERTO_SERDES
	select COMCERTO_I2C
	select COMCERTO_NAND
	help

config COMCERTO_BOOTLOADER
	bool "Bootloader Code"
	select COMCERTO_SERDES if !MACH_COMCERTO_C2K_RTSM
	select COMCERTO_I2C
	select COMCERTO_NAND if !MACH_COMCERTO_C2K_RTSM
	select COMCERTO_SATA
	help

config COMCERTO_ULOADER
	bool "ULoader Code"
	select HAVE_NOSHELL
	select COMCERTO_PLL if !MACH_COMCERTO_C2K_RTSM
	select COMCERTO_DDR if !MACH_COMCERTO_C2K_RTSM
	select COMCERTO_NAND if !MACH_COMCERTO_C2K_RTSM
#       select COMCERTO_DDR_ECC if !MACH_COMCERTO_C2K_RTSM
#	select COMCERTO_DDR_TRAINING if !MACH_COMCERTO_C2K_RTSM
	help

config COMCERTO_NAND_ULOADER
	bool "NAND ULoader Code"
	select COMCERTO_PLL if !MACH_COMCERTO_C2K_RTSM
	select COMCERTO_DDR if !MACH_COMCERTO_C2K_RTSM
	select COMCERTO_NAND if !MACH_COMCERTO_C2K_RTSM
#       select COMCERTO_DDR_ECC if !MACH_COMCERTO_C2K_RTSM
	help

config COMCERTO_JTAG_ULOADER
	bool "JTAG ULoader Code"
	select HAVE_NOSHELL
	select COMCERTO_PLL if !MACH_COMCERTO_C2K_RTSM
	select COMCERTO_DDR if !MACH_COMCERTO_C2K_RTSM
	help
		Build a ULoader which will load Barebox via the JTAG TAP.

		The JTAG ULoader will execute a BKPT instruction to cause the CPU to halt
		in debug mode, allowing the host to write Barebox image directly into DDR.
		When done, the host can resume execution to run the bootloader.

endchoice

endmenu

config COMCERTO_PLL
	bool

config COMCERTO_DDR
	bool

config COMCERTO_NAND
	bool

config COMCERTO_SERDES
	bool

config COMCERTO_I2C
	bool

config COMCERTO_DDR_TRAINING
        bool

config COMCERTO_DDR_ECC
	bool

config COMCERTO_SATA
	bool

config M86201
	bool "M86201 SKU"
	select M8620X

config M86202
	bool "M86202 SKU"
	select M8620X

config M86203
	bool "M86203 SKU"
	select M8620X

config M86204
	bool "M86204 SKU"
	select M8620X

config M86206
	bool "M86206 SKU"
	select M8620X

config M86207
	bool "M86207 SKU"
	select M8620X

config M86208
	bool "M86208 SKU"
	select M8620X

config M8620X
	bool "M8620X series SKUs"

config M86260
	bool "M86260 SKU"
	select M8626X

config M86261
	bool "M86261 SKU"
	select M8626X

config M86261_NAS
	bool "M86261_NAS SKU"
	select M8626X

config M86262
	bool "M86262 SKU"
	select M8626X

config M8626X
	bool "M8626X series SKUs"

config M86291
	bool "M86291 SKU"
	select M8629X

config M86292
	bool "M86292 SKU"
	select M8629X

config M86293
	bool "M86293 SKU"
	select M8629X

config M86294
	bool "M86294 SKU"
	select M8629X

config M86295
	bool "M86295 SKU"
	select M8629X

config M86296
	bool "M86296 SKU"
	select M8629X

config M86297
	bool "M86297 SKU"
	select M8629X

config M86298
	bool "M86298 SKU"
	select M8629X

config M8629X
	bool "M8629X series SKUs"

endmenu
```

## diags/Kconfig
```kconfig
if (COMCERTO_VERIFICATION || COMCERTO_DIAG)

config COMCERTO_TEST
	bool
	default y

menu "Comcerto Diagnostic Configuration"

config COMCERTO_VERIFICATION_DDR
        bool "DDR Verification Testing"
        depends on COMCERTO_VERIFICATION
	select COMCERTO_TEST_DDR
        default y
        help

config COMCERTO_VERIFICATION_PFE
        bool "PFE Verification Testing"
        depends on COMCERTO_VERIFICATION
	select COMCERTO_TEST_PFE
        default y
        help

config COMCERTO_VERIFICATION_TZ
        bool "TrustZone Verification Testing"
        depends on COMCERTO_VERIFICATION
	select COMCERTO_TEST_TZ
        default y
        help

config COMCERTO_VERIFICATION_L2CC
	bool "L2CC Verification Testing"
	depends on COMCERTO_VERIFICATION
	select COMCERTO_TEST_L2CC
	default y
	help

config COMCERTO_VERIFICATION_DUALCORE
        bool "DualCore Verification Testing"
        depends on COMCERTO_VERIFICATION
        select COMCERTO_TEST_DUALCORE
        default y
        help

config COMCERTO_DIAG_DDR
        bool "DDR Diag Testing"
        depends on COMCERTO_DIAG
	select COMCERTO_TEST_DDR
        default y
        help

config COMCERTO_DIAG_PFE
        bool "PFE Diag Testing"
        depends on COMCERTO_DIAG
	select COMCERTO_TEST_PFE
        default n

config COMCERTO_DIAG_TZ
        bool "TrustZone Diag Testing"
        depends on COMCERTO_DIAG
	select COMCERTO_TEST_TZ
        default n

config COMCERTO_DIAG_L2CC
        bool "L2CC Diag Testing"
        depends on COMCERTO_DIAG
        select COMCERTO_TEST_L2CC
        default n
        help

config COMCERTO_DIAG_DECT
	bool "DECT Diag Testing"
	depends on COMCERTO_DIAG
	select COMCERTO_TEST_DECT
	default n

config COMCERTO_DIAG_PCIE
	bool "PCIE Verification API"
	depends on COMCERTO_DIAG
	select COMCERTO_TEST_PCIE
	default n
	help

config COMCERTO_DIAG_FUART
	bool "Fast UART Testing"
	depends on COMCERTO_DIAG
	depends on MACH_COMCERTO_C2K_ASIC
	select COMCERTO_TEST_FUART
	default y
	help

config COMCERTO_DIAG_NOR
	bool "NOR Diag Testing"
	depends on COMCERTO_DIAG
	select COMCERTO_TEST_NOR
	default n
	help

config COMCERTO_DIAG_UTILPE_IPSEC
        bool "Utilpe ipsec testing"
        depends on COMCERTO_DIAG
        select COMCERTO_TEST_UTILPE_IPSEC
        default n
        help

config COMCERTO_DIAG_ZDSTDM
	bool "ZDS/TDM Diag Testing"
	depends on COMCERTO_DIAG
	select COMCERTO_TEST_ZDSTDM
	default n
	help

config COMCERTO_DIAG_ZDS_SLIC
	bool "ZDS/SLIC Diag Testing"
	depends on COMCERTO_DIAG
	select COMCERTO_TEST_ZDS_SLIC
	default n
	help

config COMCERTO_DIAG_SPI
	bool "SPI Diag Testing"
	depends on COMCERTO_DIAG
	select SPI
	select DRIVER_SPI_C2K
	select DRIVER_FAST_SPI_C2K
	select COMCERTO_TEST_SPI
	default y
	help

config COMCERTO_DIAG_MSIF_TDM
	bool "MSIF/TDM Diag Testing"
	depends on COMCERTO_DIAG
	select COMCERTO_TEST_MSIF_TDM
	default n
	help

config COMCERTO_DIAG_MSIF_SLIC
	bool "MSIF/SLIC Diag Testing"
	depends on COMCERTO_DIAG
	select COMCERTO_TEST_MSIF_SLIC
	default n
	help

config COMCERTO_DIAG_I2C
	bool "I2C Diag Testing"
	depends on COMCERTO_DIAG
	select COMCERTO_TEST_I2C
	default n
	help

config COMCERTO_DIAG_OTP
	bool "OTP Diag Testing"
	select COMCERTO_TEST_OTP
	default n
	help

config COMCERTO_DIAG_USB3
        bool "USB3.0 Diag Testing"
        select COMCERTO_TEST_USB3
        default n
        help

config COMCERTO_DIAG_NAND_ECC
       bool "NAND ECC Diag Testing"
       select COMCERTO_TEST_NAND_ECC
       default n
       help

config COMCERTO_DIAG_SATA
	bool "SATA Diag Testing"
	select COMCERTO_TEST_SATA
	default n
	help

endmenu

config COMCERTO_TEST_DDR
	bool

config COMCERTO_TEST_PFE
	bool

config COMCERTO_TEST_TZ
	bool

config COMCERTO_TEST_DECT
	bool

config COMCERTO_TEST_DUALCORE
        bool

config COMCERTO_TEST_PCIE
	bool

config COMCERTO_TEST_FUART
        bool

config COMCERTO_TEST_NOR
	bool

config COMCERTO_TEST_ZDSTDM
	bool

config COMCERTO_TEST_ZDS_SLIC
	bool

config COMCERTO_TEST_SPI
	bool

config COMCERTO_TEST_MSIF_TDM
	bool

config COMCERTO_TEST_MSIF_SLIC
	bool

config COMCERTO_TEST_I2C
	bool

config COMCERTO_TEST_OTP
	bool

config COMCERTO_TEST_USB3
        bool

config COMCERTO_TEST_UTILPE_IPSEC
       bool

config COMCERTO_TEST_NAND_ECC
       bool

config COMCERTO_TEST_SATA
	bool

endif
```

## drivers/net/comcerto/Kconfig
```kconfig
menuconfig NET_COMCERTO
	depends on ARCH_COMCERTO
	bool "Comcerto network support"

if NET_COMCERTO

config NET_COMCERTO_2000
	select MIIDEV
	bool "Comcerto-2000 Ethernet driver"

config AR8328_SWITCH
	depends on NET_COMCERTO_2000
	depends on MACH_COMCERTO_C2K_EVM || MACH_COMCERTO_C2K_MFCNEVM
	bool "AR8328 Switch Driver"
	default y

endif
```

## drivers/otp/Kconfig
```kconfig
menu "OTP driver                "

config OTP
	bool "Enable OTP driver support"
	default y

config DRIVER_OTP
	depends on ARCH_COMCERTO
	default n
	bool "Comcerto OTP driver"

endmenu
```

## drivers/spi/Kconfig
```kconfig
menu "SPI drivers                   "

config SPI
	bool "Enable SPI driver support"
	default y

config DRIVER_SPI_IMX
	bool "i.MX SPI Master driver"
	depends on ARCH_IMX
	depends on SPI

config DRIVER_SPI_IMX_0_0
	bool
	depends on ARCH_IMX27
	default y

config DRIVER_SPI_IMX_2_3
	bool
	depends on ARCH_IMX51
	default y

config DRIVER_SPI_C2K
	bool "C2K SPI driver"
	depends on SPI
	default y

config DRIVER_FAST_SPI_C2K
	bool "C2K FAST SPI driver"
	depends on SPI
	default n

config C2K_SPI_API
	bool "C2K SPI API support"
	depends on DRIVER_SPI_C2K || DRIVER_FAST_SPI_C2K
	default y

config C2K_SPI_COMMON
	bool "C2K SPI common"
	depends on SPI
	depends on DRIVER_SPI_C2K || DRIVER_FAST_SPI_C2K
	default y

config CSI_FLASH
	bool "Common SPI Interface (CSI) driver"
	depends on SPI
	depends on DRIVER_SPI_C2K || DRIVER_FAST_SPI_C2K
	default n

config SPI_FLASH
	bool "C2K SPI Flash driver"
	depends on SPI
	depends on DRIVER_SPI_C2K || DRIVER_FAST_SPI_C2K
	depends on !COMCERTO_NAND_ULOADER
	default y

config FAST_SPI_FLASH
	bool "C2K Fast SPI Flash driver"
	depends on DRIVER_FAST_SPI_C2K
	depends on !COMCERTO_NAND_ULOADER
	default y

endmenu
```
